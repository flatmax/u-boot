/dts-v1/;

#include "fsl-imx8mm-sue-s195x-common.dtsi"

&fec1 {
	pinctrl-names = "default";
	pinctrl-0 = <&pinctrl_fec1>;
	status = "okay";
	phy-mode = "rmii";
};

&iomuxc {
	imx8mm-s195x-prime {
		pinctrl_fec1: fec1grp {
			fsl,pins = <
				MX8MM_IOMUXC_ENET_MDC_ENET1_MDC			(IOMUX_CONFIG_SION | PAD_CTL_DSE6x)
				MX8MM_IOMUXC_ENET_MDIO_ENET1_MDIO		(PAD_CTL_DSE6x)
				MX8MM_IOMUXC_ENET_TD2_ENET1_TX_CLK		(IOMUX_CONFIG_SION | PAD_CTL_SLOW | PAD_CTL_DSE1x)
				MX8MM_IOMUXC_ENET_TD1_ENET1_RGMII_TD1		(PAD_CTL_FAST | PAD_CTL_DSE6x)
				MX8MM_IOMUXC_ENET_TD0_ENET1_RGMII_TD0		(PAD_CTL_FAST | PAD_CTL_DSE6x)
				MX8MM_IOMUXC_ENET_TX_CTL_ENET1_RGMII_TX_CTL	(PAD_CTL_FAST | PAD_CTL_DSE6x)
				MX8MM_IOMUXC_ENET_RX_CTL_ENET1_RGMII_RX_CTL	(PAD_CTL_HYS | PAD_CTL_FAST)
				MX8MM_IOMUXC_ENET_RXC_ENET1_RX_ER		(PAD_CTL_HYS | PAD_CTL_FAST)
				MX8MM_IOMUXC_ENET_RD0_ENET1_RGMII_RD0		(PAD_CTL_HYS | PAD_CTL_FAST)
				MX8MM_IOMUXC_ENET_RD1_ENET1_RGMII_RD1		(PAD_CTL_HYS | PAD_CTL_FAST)
				MX8MM_IOMUXC_ENET_RD2_GPIO1_IO28		(PAD_CTL_PE_UP | PAD_CTL_HYS | PAD_CTL_FAST)	/* PHY_INT_N */
				MX8MM_IOMUXC_ENET_RD3_GPIO1_IO29		(PAD_CTL_PE_UP | PAD_CTL_HYS | PAD_CTL_FAST)	/* PHY_RST_N */

			>;
		};
	};
};
