## board/streamunlimited/Kconfig
```kconfig
config SUE_S1832
	bool "Support StreamUnlimited stream1832 module"
	default n

if SUE_S1832
source "board/streamunlimited/stream1832/Kconfig"
endif
```

## board/streamunlimited/common/Kconfig
```kconfig
config SUE_ADC_CARRIER_DETECT
	bool "Support ADC carrier board detection for StreamUnlimited targets"
	default n
	help
	  This allows the automatic detection of carrier (+daughter) boards
	  using an ADC. However some targets (like Stream195x) do not have
	  an ADC on the SoC, for that reson this option is disabled per default.
	  If you enabled it, you must provide the ADC readout code in the
	  device_interface.c file.
```

## board/streamunlimited/stream1832/Kconfig
```kconfig
if TARGET_MESON_AXG

config SYS_CPU
	string
	default "armv8"

config SYS_BOARD
	string
	default "stream1832"

config SYS_VENDOR
	string
	default "streamunlimited"

config SYS_SOC
	string
	default "axg"

config SYS_CONFIG_NAME
	default "stream1832"

endif
```

## board/streamunlimited/stream195x/Kconfig
```kconfig
if TARGET_STREAM195X

config SYS_BOARD
	default "stream195x"

config SYS_VENDOR
	default "streamunlimited"

config SYS_CONFIG_NAME
	default "stream195x"

source "board/streamunlimited/common/Kconfig"
source "board/streamunlimited/fsl_common/Kconfig"

endif
```

## configs/stream1832_defconfig
```kconfig
CONFIG_ARM=y
CONFIG_TARGET_MESON_AXG=y
CONFIG_SUE_S1832=y
CONFIG_DM=y
CONFIG_DM_GPIO=y
CONFIG_AML_GPIO=y
CONFIG_ENABLE_VBOOT=y
CONFIG_RSA=y
CONFIG_FIT=y
CONFIG_FIT_SIGNATURE=y
CONFIG_OF_CONTROL=y
CONFIG_OF_SEPARATE=y
CONFIG_OF_LIBFDT=y
CONFIG_DEFAULT_DEVICE_TREE="s1832"
```
